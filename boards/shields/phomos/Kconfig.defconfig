## boards/shields/phomos/Kconfig.defconfig
```kconfig
# Copyright (c) 2022 The ZMK Contributors
# SPDX-License-Identifier: MIT

if SHIELD_PHOMOS_LEFT

config ZMK_KEYBOARD_NAME
    default "Phomos"

config ZMK_SPLIT_ROLE_CENTRAL
    default y

endif

if SHIELD_PHOMOS_LEFT || SHIELD_PHOMOS_RIGHT

config ZMK_SPLIT
    default y

endif
```

## config/boards/shields/phomos/Kconfig.shield
```kconfig
# Copyright (c) 2022 The ZMK Contributors
# SPDX-License-Identifier: MIT

config SHIELD_PHOMOS_LEFT
    def_bool $(shields_list_contains,phomos_left)

config SHIELD_PHOMOS_RIGHT
    def_bool $(shields_list_contains,phomos_right)
```
